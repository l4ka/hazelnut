## apps/xconfig/config.in
```kconfig
mainmenu_name "L4/KA Userland Configuration"

source arch.in

source kernel.in

# source debugger.in

source apps.in

endmenu
```

## apps/xconfig/defconfig
```kconfig
#
CONFIG_ARCH_X86=y
#
CONFIG_ARCH_X86_I586=y
CONFIG_ARCH_ARM_DNARD=y
CONFIG_ARCH_MIPS_R4000=y
CONFIG_ARCH_SH_EMU=y
CONFIG_ARCH_M68K_DRAGONBALL=y
#
CONFIG_VERSION_X0=y

CONFIG_BUILD_SIGMA0=y
#
CONFIG_LIBIO_OUTSCRN=y
```

## kernel/xconfig/config.in
```kconfig
######################################################################
##                
## Copyright (C) 1999, 2000, 2001,  Karlsruhe University
##                
## File path:     config.in
## Description:   Main configuration specification file.
##                
## @LICENSE@
##                
## $Id: config.in,v 1.4 2001/11/22 15:57:34 skoglund Exp $
##                
######################################################################

mainmenu_name "L4/KA Configuration"

source arch.in

source kernel.in

source debugger.in

source trace.in

endmenu
```

## kernel/xconfig/defconfig
```kconfig
######################################################################
##                
## Copyright (C) 1999, 2000, 2001, 2003,  Karlsruhe University
##                
## File path:     xconfig/defconfig
## Description:   Default configuration.
##                
## @LICENSE@
##                
## $Id: defconfig,v 1.8 2003/04/26 22:57:05 ud3 Exp $
##                
######################################################################
#
CONFIG_ARCH_X86=y
#
CONFIG_ARCH_X86_I686=y
CONFIG_ARCH_ARM_DNARD=y
CONFIG_ARCH_MIPS_R4000=y
CONFIG_ARCH_SH_EMU=y
CONFIG_ARCH_M68K_DRAGONBALL=y
#
CONFIG_VERSION_X0=y
CONFIG_JOCHEN_BUGS=n
#
CONFIG_DEBUGGER_KDB=y
CONFIG_DEBUGGER_IO_INCOM=y
CONFIG_DEBUGGER_IO_OUTCOM=y
CONFIG_DEBUGGER_IO_SCREEN_VGA=y
CONFIG_DEBUGGER_IO_KBD_US=y

CONFIG_DEBUG=y
CONFIG_DEBUG_TRACE_KPF=y
CONFIG_DEBUG_TRACE_UPF=y
CONFIG_DEBUG_TRACE_IPC=y
CONFIG_DEBUG_TRACE_MDB=y
CONFIG_DEBUG_BREAKIN=y
CONFIG_DEBUG_KDB_ONSTART=y
```
